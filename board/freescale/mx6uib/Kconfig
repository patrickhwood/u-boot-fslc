## board/freescale/mx6uib/Kconfig
```kconfig
if TARGET_MX6UIB

config SYS_CPU
	default "armv7"

config SYS_BOARD
	default "mx6uib"

config SYS_VENDOR
	default "freescale"

config SYS_SOC
	default "mx6"

config SYS_CONFIG_NAME
	default "mx6uib"

endif
```

## configs/mx6dluib_defconfig
```kconfig
CONFIG_SYS_EXTRA_OPTIONS="IMX_CONFIG=board/freescale/mx6uib/mx6dluib.cfg,MX6DL"
CONFIG_ARM=y
CONFIG_TARGET_MX6UIB=y
```
